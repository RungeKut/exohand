/* USER CODE BEGIN Header */
/**
  ******************************************************************************
  * @file           : main.c
  * @brief          : Main program body
  ******************************************************************************
  * @attention
  *
  * <h2><center>&copy; Copyright (c) 2021 STMicroelectronics.
  * All rights reserved.</center></h2>
  *
  * This software component is licensed by ST under Ultimate Liberty license
  * SLA0044, the "License"; You may not use this file except in compliance with
  * the License. You may obtain a copy of the License at:
  *                             www.st.com/SLA0044
  *
  ******************************************************************************
  */
/* USER CODE END Header */
/* Includes ------------------------------------------------------------------*/
#include "main.h"
#include "adc.h"
#include "crc.h"
#include "tim.h"
#include "usb_device.h"
#include "gpio.h"

/* Private includes ----------------------------------------------------------*/
/* USER CODE BEGIN Includes */
#include "usbd_cdc_if.h"
/* USER CODE END Includes */

/* Private typedef -----------------------------------------------------------*/
/* USER CODE BEGIN PTD */

/* USER CODE END PTD */

/* Private define ------------------------------------------------------------*/
/* USER CODE BEGIN PD */
extern char str_rx[100];
extern char data_rx[96];
/* USER CODE END PD */

/* Private macro -------------------------------------------------------------*/
/* USER CODE BEGIN PM */

/* USER CODE END PM */

/* Private variables ---------------------------------------------------------*/

/* USER CODE BEGIN PV */

/* USER CODE END PV */

/* Private function prototypes -----------------------------------------------*/
void SystemClock_Config(void);
/* USER CODE BEGIN PFP */

/* USER CODE END PFP */

/* Private user code ---------------------------------------------------------*/
/* USER CODE BEGIN 0 */


	uint16_t ServoAngle = 0;
	uint8_t Flag = 0;
	const	uint16_t AngleToCCR [] = {
0x1F40, 0x1F51, 0x1F62, 0x1F74, 0x1F85, 0x1F96, 0x1FA8, 0x1FB9, 0x1FCA, 0x1FDC, 0x1FED, 0x1FFF,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 0x2363,
0x2374, 0x2386, 0x2397, 0x23A9, 0x23BA, 0x23CB, 0x23DD, 0x23EE, 0x23FF, 0x2411, 0x2422, 0x2433,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 0x2798,
0x27A9, 0x27BB, 0x27CC, 0x27DD, 0x27EF, 0x2800, 0x2812, 0x2823, 0x2834, 0x2846, 0x2857, 0x2868,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 0x2BCD,
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0x7BCC, 0x7BDD, 0x7BEF, 0x7C00, 0x7C11, 0x7C23, 0x7C34, 0x7C45, 0x7C57, 0x7C68, 0x7C7A, 0x7C8B,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 0x7E1A, 0x7E2C };
void TurnServoAngle(uint32_t Angle)
{
		LL_TIM_OC_SetCompareCH3(TIM3, AngleToCCR[Angle]);
}

void ServoGo(uint16_t Angle)
{
		if (Flag == 0)
		{
			if (ServoAngle < Angle)
			{
				ServoAngle = ServoAngle + 1;
			}
			else
			{
				Flag = 1;
			}
		}
		else
		{
			if (ServoAngle > 0)
			{
				ServoAngle = ServoAngle - 1;
			}
			else
			{
				Flag = 0;
			}
		}
		TurnServoAngle(ServoAngle);
//		LL_mDelay(1);
}
/* USER CODE END 0 */

/**
  * @brief  The application entry point.
  * @retval int
  */
int main(void)
{
  /* USER CODE BEGIN 1 */

  /* USER CODE END 1 */

  /* MCU Configuration--------------------------------------------------------*/

  /* Reset of all peripherals, Initializes the Flash interface and the Systick. */
  HAL_Init();

  /* USER CODE BEGIN Init */

  /* USER CODE END Init */

  /* Configure the system clock */
  SystemClock_Config();

  /* USER CODE BEGIN SysInit */

  /* USER CODE END SysInit */

  /* Initialize all configured peripherals */
  MX_GPIO_Init();
  MX_ADC_Init();
  MX_TIM3_Init();
  MX_USB_DEVICE_Init();
  MX_TIM22_Init();
  MX_CRC_Init();
  /* USER CODE BEGIN 2 */
  LL_GPIO_SetOutputPin(EN_DC_DC_GPIO_Port, EN_DC_DC_Pin);
  LL_TIM_CC_EnableChannel(TIM3, LL_TIM_CHANNEL_CH3);
  LL_TIM_EnableCounter(TIM3);
  LL_TIM_OC_SetCompareCH3(TIM3, 0x1F40);
  LL_TIM_CC_EnableChannel(TIM22, LL_TIM_CHANNEL_CH1);
  LL_TIM_EnableCounter(TIM22);
  LL_TIM_OC_SetCompareCH1(TIM22, 0x16);

  LL_GPIO_SetOutputPin(Vibration_GPIO_Port, Vibration_Pin);
  LL_TIM_EnableCounter(TIM22);
  LL_mDelay(100);
  LL_GPIO_ResetOutputPin(Vibration_GPIO_Port, Vibration_Pin);
//  LL_TIM_DisableCounter(TIM22);
  LL_mDelay(100);
  LL_GPIO_SetOutputPin(Vibration_GPIO_Port, Vibration_Pin);
  LL_mDelay(100);
  LL_GPIO_ResetOutputPin(Vibration_GPIO_Port, Vibration_Pin);


  /* USER CODE END 2 */

  /* Infinite loop */
  /* USER CODE BEGIN WHILE */
  while (1)
  {

//	LL_mDelay(1000);
//	CDC_Transmit_FS(str_rx, strlen(str_rx));
	TurnServoAngle(data_rx[1] + data_rx[0] * 256);

//	ServoGo(1200);
//	TurnServoAngle(1200);
//	LL_mDelay(5000);
//	TurnServoAngle(0);
//	LL_mDelay(5000);
    /* USER CODE END WHILE */

    /* USER CODE BEGIN 3 */
  }
  /* USER CODE END 3 */
}

/**
  * @brief System Clock Configuration
  * @retval None
  */
void SystemClock_Config(void)
{
  LL_FLASH_SetLatency(LL_FLASH_LATENCY_1);
  while(LL_FLASH_GetLatency()!= LL_FLASH_LATENCY_1)
  {
  }
  LL_PWR_SetRegulVoltageScaling(LL_PWR_REGU_VOLTAGE_SCALE1);
  LL_RCC_HSE_Enable();

   /* Wait till HSE is ready */
  while(LL_RCC_HSE_IsReady() != 1)
  {

  }
  LL_RCC_PLL_ConfigDomain_SYS(LL_RCC_PLLSOURCE_HSE, LL_RCC_PLL_MUL_12, LL_RCC_PLL_DIV_3);
  LL_RCC_PLL_Enable();

   /* Wait till PLL is ready */
  while(LL_RCC_PLL_IsReady() != 1)
  {

  }
  LL_RCC_SetAHBPrescaler(LL_RCC_SYSCLK_DIV_1);
  LL_RCC_SetAPB1Prescaler(LL_RCC_APB1_DIV_1);
  LL_RCC_SetAPB2Prescaler(LL_RCC_APB2_DIV_1);
  LL_RCC_SetSysClkSource(LL_RCC_SYS_CLKSOURCE_PLL);

   /* Wait till System clock is ready */
  while(LL_RCC_GetSysClkSource() != LL_RCC_SYS_CLKSOURCE_STATUS_PLL)
  {

  }
  LL_SetSystemCoreClock(32000000);

   /* Update the time base */
  if (HAL_InitTick (TICK_INT_PRIORITY) != HAL_OK)
  {
    Error_Handler();
  }
  LL_RCC_SetUSBClockSource(LL_RCC_USB_CLKSOURCE_PLL);
}

/* USER CODE BEGIN 4 */

/* USER CODE END 4 */

/**
  * @brief  This function is executed in case of error occurrence.
  * @retval None
  */
void Error_Handler(void)
{
  /* USER CODE BEGIN Error_Handler_Debug */
  /* User can add his own implementation to report the HAL error return state */

  /* USER CODE END Error_Handler_Debug */
}

#ifdef  USE_FULL_ASSERT
/**
  * @brief  Reports the name of the source file and the source line number
  *         where the assert_param error has occurred.
  * @param  file: pointer to the source file name
  * @param  line: assert_param error line source number
  * @retval None
  */
void assert_failed(uint8_t *file, uint32_t line)
{
  /* USER CODE BEGIN 6 */
  /* User can add his own implementation to report the file name and line number,
     tex: printf("Wrong parameters value: file %s on line %d\r\n", file, line) */
  /* USER CODE END 6 */
}
#endif /* USE_FULL_ASSERT */

/************************ (C) COPYRIGHT STMicroelectronics *****END OF FILE****/
